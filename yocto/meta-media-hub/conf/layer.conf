## yocto/meta-media-hub/conf/layer.conf
```bitbake
# We have a conf and classes directory, add to BBPATH
BBPATH .= ":${LAYERDIR}"

# We have recipes-* directories, add to BBFILES
BBFILES += "${LAYERDIR}/recipes-*/*/*.bb \
            ${LAYERDIR}/recipes-*/*/*.bbappend"

BBFILE_COLLECTIONS += "meta-media-hub"
BBFILE_PATTERN_meta-media-hub = "^${LAYERDIR}/"
BBFILE_PRIORITY_meta-media-hub = "6"

LAYERDEPENDS_meta-media-hub = "core"
LAYERSERIES_COMPAT_meta-media-hub = "scarthgap"
```
